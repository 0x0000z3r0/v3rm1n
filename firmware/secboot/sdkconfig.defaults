## firmware/secboot/sdkconfig.defaults
```kconfig
CONFIG_ESP32C3_REV_MIN_3=y
CONFIG_PARTITION_TABLE_OFFSET=0x10000
CONFIG_SECURE_BOOT=y
CONFIG_SECURE_BOOT_V2_ENABLED=y
CONFIG_SECURE_BOOT_BUILD_SIGNED_BINARIES=y
```
